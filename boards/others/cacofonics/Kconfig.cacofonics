## boards/others/cacofonics/board.yml
```yaml
board:
  name: cacofonics
  full_name: CacofonICS
  socs:
    - name: stm32l412xx
```

## drivers/Kconfig
```kconfig
menu "Drivers"
rsource "led_strip/Kconfig"
rsource "sensor/Kconfig"
rsource "servo/Kconfig"
rsource "input/Kconfig"
rsource "gnss/Kconfig"
endmenu
```

## drivers/devices/RunCam/Kconfig
```kconfig
menuconfig RUNCAM
    bool "RunCam Split 4 Device Protocol support"
    default y
    depends on DT_HAS_RUNCAM_SPLIT4_ENABLED 
    select SERIAL
    select UART_INTERRUPT_DRIVEN
    help
      Enables support for the RunCam Device protocol.
      Allows you to start/stop recording and read camera information via UART.

if RUNCAM

config RUNCAM_INIT_PRIORITY
    int "RunCam driver init priority"
    default 90
    help
      Initialization priority of RunCam driver

module = RUNCAM
module-str = runcam
source "subsys/logging/Kconfig.template.log_config"

endif # RUNCAM
```

## drivers/input/Kconfig
```kconfig
config ENCODER_INPUT
    bool "Encoder input driver"
    default n
    help
        Rotary encoder input driver for menu navigation
config ENCODER_INPUT_LOG_LEVEL
    int "Encoder input driver log level"
    default 4
    depends on ENCODER_INPUT
    help
        Log level for the encoder_input module.
        0=OFF, 1=ERROR, 2=WARNING, 3=INFO, 4=DEBUG
```

## drivers/servo/st3215/Kconfig
```kconfig
config ST3215_SERVO
    bool "Waveshare ST3215 Serial Bus Servo driver"
    default y
    depends on DT_HAS_WAVESHARE_ST3215_ENABLED
    depends on UART_ASYNC_API
    select DMA
    help
      Enable the Waveshare ST3215 servo driver.
      Uses UART async API with DMA for efficient half-duplex communication.
```

## dts/bindings/devices/runcam,split4.yaml
```yaml
description: RunCam Split 4 Device Protocol over UART

compatible: "runcam,split4"

include: base.yaml

bus: uart
```

## dts/bindings/servo/waveshare,st3215.yaml
```yaml
description: Waveshare ST3215 serial bus servo motor

compatible: "waveshare,st3215"

include: base.yaml

properties:
  servo-id:
    type: int
    required: false
    default: 1
    description: Servo ID (1-253)
  speed:
    type: int
    required: false
    default: 0
    description: Goal speed (0=maximum, 1-4095=limited)
  time-ms:
    type: int
    required: false
    default: 0
    description: Goal time in milliseconds (0=use speed register)
```

## modules/demo/Kconfig
```kconfig
menuconfig MAVWRAP
	bool "MAVLink Wrapper"
	help
	  Enable MAVLink communication wrapper with support for
	  multiple transport types (UART, UDP network).

if MAVWRAP

choice MAVWRAP_DIALECT
	prompt "MAVLink Dialect"
	default MAVWRAP_DIALECT_COMMON
	help
	  Select the MAVLink message dialect to use.
	  The dialect determines which message set is available.

config MAVWRAP_DIALECT_COMMON
	bool "common"
	help
	  MAVLink common dialect. Includes the base message set
	  shared across all MAVLink implementations.

config MAVWRAP_DIALECT_CUSTOM
	bool "obelics"
	help
	  A custom MAVLink dialect. Set MAVWRAP_DIALECT_NAME to the
	  folder name generated by mavgen.

endchoice

endif

# Automatically set for built-in dialects, user-defined for custom
config MAVWRAP_DIALECT_NAME
	string "MAVLink dialect folder name"
	default "common"          if MAVWRAP_DIALECT_COMMON
	default "obelics"                if MAVWRAP_DIALECT_CUSTOM
	help
	  The folder name of the dialect as generated by mavgen.
	  Automatically set for built-in dialects. For custom dialects,
	  set this to the XML filename used to generate the headers.


config LIB_DEMO
    bool "Demo peripherals control"
    default n
    depends on SERVO
    depends on LED_STRIP
    help
        Neopixel LED and ST3215 servo demo animations, exposed through the menu and (optionally) MAVLink.
if LIB_DEMO
config LIB_DEMO_LOG_LEVEL
    int "Demo module log level"
    default 3
    range 0 4
    help
        0=OFF, 1=ERROR, 2=WARNING, 3=INFO, 4=DEBUG
config LIB_DEMO_MAVLINK
    bool "Demo MAVLink command interface"
    default n
    depends on MAVWRAP
    help
        Handle custom OBELICS_DEMO_* MAVLink messages to trigger demos.
endif # LIB_DEMO
```

## modules/menu/Kconfig
```kconfig
config LIB_MENU
    bool "Menu system for display"
    default n
    depends on LIB_DISPLAY
    depends on ENCODER_INPUT
    help
        Menu system with encoder navigation for OLED display

if LIB_MENU

config LIB_MENU_STACK_SIZE
    int "Menu thread stack size"
    default 2048
    help
        Stack size for the menu thread

config LIB_MENU_PRIORITY
    int "Menu thread priority"
    default 10
    help
        Priority for the menu thread (lower = higher priority, 0-64)

config LIB_MENU_MIN_REDRAW_MS
    int "Minimum redraw interval (ms)"
    default 200
    help
        Minimum time between data-triggered redraws to prevent flicker

endif # LIB_MENU
```

## west.yml
```yaml
manifest:
  remotes:
    - name: zephyrproject-rtos
      url-base: https://github.com/zephyrproject-rtos

  projects:
    - name: zephyr
      remote: zephyrproject-rtos
      revision: v4.4.0
      path: zephyr
      import:
        name-allowlist:
          - cmsis_6
          - hal_stm32
          - loramac-node
          - lora-basics-modem
          - hal_semtech
          - fatfs
          - hal_espressif

    - name: zephyr-mavlink
      url: https://github.com/RedPropulsion/zephyr-mavlink.git
      revision: main
      path: modules/zephyr-mavlink
      submodules: true
```
