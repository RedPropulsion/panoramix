## Kconfig
```kconfig
## Note: this file is included by `zephyr/module.yml`

rsource "drivers/Kconfig"
```

## drivers/dts/bindings/led_strip/panoramix,ws2812-gpio-stm32.yaml
```yaml
description: Panoramix WS2812 bit-bang GPIO driver for STM32H7

compatible: "panoramix,ws2812-gpio-stm32"

include: base.yaml

properties:
  gpios:
    type: phandle-array
    required: true
    description: GPIO pin connected to WS2812 DIN

  chain-length:
    type: int
    required: true
    description: Number of LEDs in the strip

  cpu-mhz:
    type: int
    required: true
    description: CPU clock frequency in MHz, used to calculate bit-bang timing

  color-mapping:
    type: uint8-array
    required: true
    description: Mapping of color channels (e.g. GRB for WS2812B)
```

## drivers/gnss/Kconfig
```kconfig
# Copyright 2024
# SPDX-License-Identifier: Apache-2.0

rsource "u_blox_m10/Kconfig"
```

## drivers/gnss/u_blox_m10/Kconfig
```kconfig
# Copyright 2024
# SPDX-License-Identifier: Apache-2.0

config GNSS_U_BLOX_M10
    bool "U-BLOX MAX-M10S GNSS Module (I2C)"
    depends on GNSS
    depends on DT_HAS_U_BLOX_M10_ENABLED
    help
      Enable U-BLOX MAX-M10S GNSS driver over I2C.
```

## drivers/led_strip/Kconfig
```kconfig
config WS2812_GPIO_STM32
    bool "WS2812 bit-bang driver for STM32H7"
    depends on SOC_SERIES_STM32H7X
    select GPIO
    help
      Bit-bang WS2812 driver for STM32H7 using DWT cycle counter
      and direct BSRR register access for precise timing.
```

## drivers/sensor/h3lis/Kconfig
```kconfig
config SENSOR_H3LIS
    bool "STMicroelectronics H3LIS331DL high-g accelerometer"
    depends on DT_HAS_ST_H3LIS331DL_ENABLED
    depends on SPI
    default y
```

## drivers/sensor/hsc/Kconfig
```kconfig
config SENSOR_HSC
    bool "HSCxxxxxxx Pressure sensor"
    depends on DT_HAS_HONEYWELL_HSC_ENABLED
    select SPI
    default y
```

## drivers/sensor/ina219-rtio/Kconfig
```kconfig
config SENSOR_INA219_RTIO
	bool "MS5611 barometric pressure and temperature sensor"
	depends on DT_HAS_TI_INA219_RTIO_ENABLED
	select I2C
	select I2C_RTIO
	default n
```

## drivers/sensor/ms5611/Kconfig
```kconfig
config SENSOR_MS5611
	bool "MS5611 barometric pressure and temperature sensor"
	depends on DT_HAS_AMS_MS5611_ENABLED
	select SPI
	select SPI_RTIO
	select RTIO_OP_DELAY
	default n

if SENSOR_MS5611

config SENSOR_MS5611_ASYNC
	bool "MS5611 async API support"
	depends on SENSOR_ASYNC_API
	default y
	help
	  Enable async/non-blocking sensor API for MS5611 using RTIO.

endif
```

## drivers/servo/Kconfig
```kconfig
menuconfig SERVO
	bool "Servo Controller drivers"
	help
	  Enable servo controller drivers.

if SERVO

module = SERVO
module-str = servo
source "subsys/logging/Kconfig.template.log_config"

config SERVO_INIT_PRIORITY
	int "Servo driver init priority"
	default 90
	help
	  Servo driver initialization priority. Must be higher than UART
	  (which defaults to 50).

rsource "generic_pwm/Kconfig"
rsource "st3215/Kconfig"

endif # SERVO
```

## drivers/servo/generic_pwm/Kconfig
```kconfig
config SERVO_GENERIC_PWM
	bool "Generic PWM servo driver"
	default y
	depends on SERVO
	depends on DT_HAS_GENERIC_PWM_SERVO_ENABLED
	select PWM
	help
	  Enable the generic PWM servo driver. Supports any hobby servo
	  controlled by a standard PWM signal (typically 1-2 ms pulse at
	  50 Hz). Position feedback via get_position() returns the last
	  commanded angle only; no hardware feedback is available.
```

## dts/bindings/devices/worldsemi,ws2812-gpio.yaml
```yaml
description:
  Bit-Banging driver for WS2812
compatible:
  "ws2812-gpio"
properties:
  gpios:
    type: phandle-array
    required: true
    description: pin used to send data

  chain-length:
    type: int
    required: true

  color-mapping:
    type: array
    required: true
    description: LED colors mapped in the correct order

  delay-t1h:
    type: int
    required: true
    description: Number of NOP assembly operations to create a delay for a 1 bit, high voltage period (default value 700ns)

  delay-t1l:
    type: int
    required: true
    description: Number of NOP assembly operations to create a delay for a 1 bit, low voltage period (default value 600ns)

  delay-t0h:
    type: int
    required: true
    description: Number of NOP assembly operations to create a delay for a 0 bit, high voltage period (default value 350ns)

  delay-t0l:
    type: int
    required: true
    description: Number of NOP assembly operations to create a delay for a 0 bit, low voltage period (default value 800ns)

  reset-delay:
    type: int
    required: true
    description: Number of NOP assembly operations to create a delay to reset the communication with the LEDs (default value 8000ns)
```

## dts/bindings/gnss/u-blox,m10.yaml
```yaml
# Copyright 2024
# SPDX-License-Identifier: Apache-2.0

description: U-BLOX MAX-M10S GNSS Module (I2C)

compatible: "u-blox,m10"

include: i2c-device.yaml

properties:
  label:
    type: string
    required: true

  fix-rate-ms:
    type: int
    default: 1000
    description: Fix rate in milliseconds
```

## dts/bindings/sensor/ams,ms5611.yaml
```yaml
description: |
  Amsys Temperature and Pressure sensor accessed with SPI

compatible: "ams,ms5611"
include: [sensor-device.yaml, spi-device.yaml]
```

## dts/bindings/sensor/st,h3lis331dl.yaml
```yaml
description: |
  H3lis 3-axis acceleration sensor accessed with SPI

compatible: "st,h3lis331dl"
include: [sensor-device.yaml, spi-device.yaml]


properties:
  full-scale:
    type: int
    default: 100
    description: |
      Measurement full-scale range in g.
      Valid values: 100, 200, 400.
      Maps to CTRL_REG4 FS[1:0] bits (Table 8.5, DS9012).
    enum:
      - 100
      - 200
      - 400

  odr:
    type: int
    default: 100
    description: |
      Output data rate in Hz (normal mode).
      Valid values: 50, 100, 400, 1000.
      Maps to CTRL_REG1 DR[1:0] bits (Table 16, DS9012).
    enum:
      - 50
      - 100
      - 400
      - 1000
```

## dts/bindings/servo/generic,pwm-servo.yaml
```yaml
description: |
  Generic PWM-controlled hobby servo motor.

  The servo position is controlled by varying the pulse width of a PWM
  signal. The pulse width is linearly interpolated between min-pulse
  (0 degrees) and max-pulse (max-angle milli-degrees).

  Standard hobby servos use a 20 ms period (50 Hz) with a pulse width
  ranging from 1 ms (0 degrees) to 2 ms (180 degrees). The pulse width
  values in this binding are expressed in nanoseconds, consistent with
  Zephyr's PWM API.

  Note: this device has no position feedback wire. get_position() returns
  the last commanded angle only.

compatible: "generic,pwm-servo"

include: base.yaml

properties:
  pwms:
    type: phandle-array
    required: true
    description: |
      PWM channel used to drive the servo control signal.

      The three cells are: <&pwm_controller channel period_ns flags>

        - pwm_controller: phandle to the PWM controller node
        - channel: PWM channel index on that controller
        - period_ns: PWM period in nanoseconds (e.g. PWM_MSEC(20) for 50 Hz)
        - flags: PWM_POLARITY_NORMAL or PWM_POLARITY_INVERTED

      Example:
        pwms = <&pwm0 0 PWM_MSEC(20) PWM_POLARITY_NORMAL>;

  min-pulse:
    type: int
    required: true
    description: |
      Minimum pulse width in nanoseconds, corresponding to 0 degrees.

      For a standard hobby servo this is typically 1000000 (1 ms).
      Use the PWM_USEC() or PWM_MSEC() macros in the overlay:
        min-pulse = <PWM_USEC(1000)>;

  max-pulse:
    type: int
    required: true
    description: |
      Maximum pulse width in nanoseconds, corresponding to max-angle.

      For a standard hobby servo this is typically 2000000 (2 ms).
      Use the PWM_USEC() or PWM_MSEC() macros in the overlay:
        max-pulse = <PWM_USEC(2000)>;

  max-angle:
    type: int
    default: 180000
    description: |
      Maximum servo travel angle in milli-degrees.

      Default is 180000 (180.000 degrees), which covers the full range
      of a standard hobby servo. Adjust for servos with a different
      mechanical range (e.g. 270000 for a 270-degree servo).

examples:
  - |
    #include <zephyr/dt-bindings/pwm/pwm.h>

    / {
        my_servo: servo {
            compatible = "generic,pwm-servo";
            pwms = <&pwm0 0 PWM_MSEC(20) PWM_POLARITY_NORMAL>;
            min-pulse = <PWM_USEC(1000)>;
            max-pulse = <PWM_USEC(2000)>;
            /* max-angle defaults to 180000 mdeg, omit if correct */
        };
    };
```

## modules/display/Kconfig
```kconfig
config LIB_DISPLAY
    bool "Display module"
    default n
    help
        Enable display module for SSD1309 OLED display
```
